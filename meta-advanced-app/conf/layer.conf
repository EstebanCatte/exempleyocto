## meta-advanced-app/conf/layer.conf
```bitbake
# We have a conf and classes directory, add to BBPATH
BBPATH .= ":${LAYERDIR}"

# We have recipes-* directories, add to BBFILES
BBFILES += "${LAYERDIR}/recipes-*/*/*.bb \
            ${LAYERDIR}/recipes-*/*/*.bbappend"

BBFILE_COLLECTIONS += "meta-advanced-app"
BBFILE_PATTERN_meta-advanced-app = "^${LAYERDIR}/"
BBFILE_PRIORITY_meta-advanced-app = "7"

LAYERDEPENDS_meta-advanced-app = "core"
LAYERSERIES_COMPAT_meta-advanced-app = "scarthgap"
```

## meta-apptest/conf/layer.conf
```bitbake
# We have a conf and classes directory, add to BBPATH
BBPATH .= ":${LAYERDIR}"

# We have recipes-* directories, add to BBFILES
BBFILES += "${LAYERDIR}/recipes-*/*/*.bb \
            ${LAYERDIR}/recipes-*/*/*.bbappend"

BBFILE_COLLECTIONS += "meta-apptest"
BBFILE_PATTERN_meta-apptest = "^${LAYERDIR}/"
BBFILE_PRIORITY_meta-apptest = "6"

LAYERDEPENDS_meta-apptest = "core"
LAYERSERIES_COMPAT_meta-apptest = "scarthgap"
```

## meta-cpustat/conf/layer.conf
```bitbake
# We have a conf and classes directory, add to BBPATH
BBPATH .= ":${LAYERDIR}"

# We have recipes-* directories, add to BBFILES
BBFILES += "${LAYERDIR}/recipes-*/*/*.bb \
            ${LAYERDIR}/recipes-*/*/*.bbappend"

BBFILE_COLLECTIONS += "meta-cpustat"
BBFILE_PATTERN_meta-cpustat = "^${LAYERDIR}/"
BBFILE_PRIORITY_meta-cpustat = "6"

LAYERDEPENDS_meta-cpustat = "core"
LAYERSERIES_COMPAT_meta-cpustat = "scarthgap"
```

## meta-git-example/conf/layer.conf
```bitbake
# We have a conf and classes directory, add to BBPATH
BBPATH .= ":${LAYERDIR}"

# We have recipes-* directories, add to BBFILES
BBFILES += "${LAYERDIR}/recipes-*/*/*.bb \
            ${LAYERDIR}/recipes-*/*/*.bbappend"

BBFILE_COLLECTIONS += "meta-git-example"
BBFILE_PATTERN_meta-git-example = "^${LAYERDIR}/"
BBFILE_PRIORITY_meta-git-example = "6"

LAYERDEPENDS_meta-git-example = "core"
LAYERSERIES_COMPAT_meta-git-example = "scarthgap"
```

## meta-git-hello/conf/layer.conf
```bitbake
# We have a conf and classes directory, add to BBPATH
BBPATH .= ":${LAYERDIR}"

# We have recipes-* directories, add to BBFILES
BBFILES += "${LAYERDIR}/recipes-*/*/*.bb \
            ${LAYERDIR}/recipes-*/*/*.bbappend"

BBFILE_COLLECTIONS += "meta-git-hello"
BBFILE_PATTERN_meta-git-hello = "^${LAYERDIR}/"
BBFILE_PRIORITY_meta-git-hello = "6"

LAYERDEPENDS_meta-git-hello = "core"
LAYERSERIES_COMPAT_meta-git-hello = "scarthgap"
```

## meta-logger/conf/layer.conf
```bitbake
# We have a conf and classes directory, add to BBPATH
BBPATH .= ":${LAYERDIR}"

# We have recipes-* directories, add to BBFILES
BBFILES += "${LAYERDIR}/recipes-*/*/*.bb \
            ${LAYERDIR}/recipes-*/*/*.bbappend"

BBFILE_COLLECTIONS += "meta-logger"
BBFILE_PATTERN_meta-logger = "^${LAYERDIR}/"
BBFILE_PRIORITY_meta-logger = "6"

LAYERDEPENDS_meta-logger = "core"
LAYERSERIES_COMPAT_meta-logger = "scarthgap"
```
